## esp_codec_dev/Kconfig
```kconfig
menu "Audio Codec Device Configuration"
    config CODEC_ES8311_SUPPORT
        bool "Support ES8311 Codec Chip"
        default y
        help
            Enable this option to support codec ES8311.

    config CODEC_ES7210_SUPPORT
        bool "Support ES7210 Codec Chip"
        default y
        help
            Enable this option to support codec ES7210.

    config CODEC_ES7243_SUPPORT
        bool "Support ES7243 Codec Chip"
        default y
        help
            Enable this option to support codec ES7243.

    config CODEC_ES7243E_SUPPORT
        bool "Support ES7243E Codec Chip"
        default y
        help
            Enable this option to support codec ES7243E.

    config CODEC_ES8156_SUPPORT
        bool "Support ES8156 Codec Chip"
        default y
        help
            Enable this option to support codec ES8156.

    config CODEC_AW88298_SUPPORT
        bool "Support AW88298 Codec Chip"
        default y
        help
            Enable this option to support codec AW88298.

    config CODEC_ES8389_SUPPORT
        bool "Support ES8389 Codec Chip"
        default y
        help
            Enable this option to support codec ES8389.

    config CODEC_ES8374_SUPPORT
        bool "Support ES8374 Codec Chip"
        default n
        help
            Enable this option to support codec ES8374.

     config CODEC_ES8388_SUPPORT
        bool "Support ES8388 Codec Chip"
        default y
        help
            Enable this option to support codec ES8388.

    config CODEC_TAS5805M_SUPPORT
        bool "Support TAS5805M Codec Chip"
        default y
        help
            Enable this option to support codec TAS5805M.

    config CODEC_ZL38063_SUPPORT
        bool "Support ZL38063 Codec Chip"
        default n
        help
            Enable this option to support codec ZL38063.
            ZL38063 firmware only support xtensa, don't enable for RISC-V IC.

    config CODEC_CJC8910_SUPPORT
        bool "Support CJC8910 Codec Chip"
        default y
        help
            Enable this option to support codec CJC8910.

    config CODEC_DUMMY_SUPPORT
        bool "Support Dummy Codec Chip"
        default y
        help
            Enable this option to support dummy codec, which is used without a codec chip

    config CODEC_UAC_SUPPORT
        bool "Support USB Audio Class device"
        default n
        depends on SOC_USB_OTG_SUPPORTED
        help
            Enable this option to support USB Audio Class devices as esp_codec_dev
            codec and data interfaces. The application must install the USB Host
            library and run the USB Host library event task before opening the
            UAC codec device.

    config CODEC_UAC_MAX_DEVICES
        int "Maximum number of UAC devices"
        default 2
        range 1 8
        depends on CODEC_UAC_SUPPORT
        help
            Maximum number of USB Audio Class devices the UAC manager can track
            simultaneously. Each physical UAC device (addressed by its USB device
            address) occupies one slot and may expose a microphone (RX) and/or a
            speaker (TX).

    config CODEC_UAC_DRV_STACK_SIZE
        int "UAC Driver Task Stack Size"
        default 4096
        depends on CODEC_UAC_SUPPORT
        help
            Stack size for the USB UAC driver background task.

    config CODEC_UAC_DRV_CORE_ID
        int "UAC Driver Task Core ID"
        default 0
        range 0 1
        depends on CODEC_UAC_SUPPORT && !FREERTOS_UNICORE
        help
            Core ID for the USB UAC driver background task.

    config CODEC_UAC_DRV_PRIORITY
        int "UAC Driver Task Priority"
        default 20
        depends on CODEC_UAC_SUPPORT
        help
            Priority for the USB UAC driver background task.

    config CODEC_DATA_ADC_SUPPORT
        bool "Support ADC continuous data interface"
        default n
        depends on SOC_ADC_SUPPORTED
        help
            Enable this option to support ADC continuous mode as an audio codec data interface.
            This allows using the on-chip ADC for audio input instead of an external codec.
endmenu
```

## esp_codec_dev/test_apps/codec_dev_test/sdkconfig.defaults
```kconfig
#
# Serial flasher config
#
CONFIG_ESPTOOLPY_FLASHFREQ_80M=y

# Enable FreeRTOS trace
CONFIG_FREERTOS_HZ=1000

#
# ESP WDT CONFIG
#
# CONFIG_TASK_WDT_PANIC is not set
CONFIG_ESP_TASK_WDT_EN=n
CONFIG_ESP_INT_WDT=n

CONFIG_ESP_CONSOLE_UART_CUSTOM=y
CONFIG_ESP_CONSOLE_UART_BAUDRATE=115200
CONFIG_LOG_DEFAULT_LEVEL_INFO=y
CONFIG_LOG_MAXIMUM_LEVEL_DEBUG=y

# Enable heap leak backtrace for verification
CONFIG_HEAP_TRACING_STANDALONE=y
CONFIG_HEAP_TRACING_STACK_DEPTH=6
```

## esp_codec_dev/test_apps/codec_dev_test/sdkconfig.defaults.esp32c3
```kconfig
CONFIG_IDF_TARGET="esp32c3"
CONFIG_IDF_TARGET_ESP32C3=y

CONFIG_COMPILER_OPTIMIZATION_PERF=y
CONFIG_FREERTOS_HZ=1000

CONFIG_CODEC_DUMMY_SUPPORT=y
CONFIG_CODEC_DATA_ADC_SUPPORT=y
```

## esp_codec_dev/test_apps/codec_dev_test/sdkconfig.defaults.esp32p4
```kconfig
CONFIG_ESP32P4_SELECTS_REV_LESS_V3=n

CONFIG_COMPILER_OPTIMIZATION_PERF=y
CONFIG_IDF_EXPERIMENTAL_FEATURES=y

CONFIG_SPIRAM=y
CONFIG_SPIRAM_MALLOC_ALWAYSINTERNAL=128
CONFIG_ESP_CONSOLE_USB_SERIAL_JTAG=y

CONFIG_ESP_SYSTEM_USE_FRAME_POINTER=y
CONFIG_PARTITION_TABLE_OFFSET=0x10000
```

## esp_codec_dev/test_apps/codec_dev_test/sdkconfig.defaults.esp32s3
```kconfig
CONFIG_IDF_CMAKE=y
CONFIG_IDF_TARGET_ARCH_XTENSA=y
CONFIG_IDF_TARGET="esp32s3"
CONFIG_IDF_TARGET_ESP32S3=y
CONFIG_IDF_FIRMWARE_CHIP_ID=0x0009

CONFIG_COMPILER_OPTIMIZATION_PERF=y
CONFIG_FREERTOS_HZ=1000

CONFIG_ESP_DEFAULT_CPU_FREQ_MHZ_240=y
CONFIG_ESP32S3_DATA_CACHE_LINE_64B=y

CONFIG_SPIRAM=y
CONFIG_SPIRAM_MODE_OCT=y
CONFIG_SPIRAM_SPEED_80M=y
CONFIG_SPIRAM_MALLOC_ALWAYSINTERNAL=128

CONFIG_PM_ENABLE=y
```

## esp_codec_dev/test_apps/codec_dev_test/sdkconfig.defaults.esp32s31
```kconfig
#
# ESP WDT CONFIG
#
CONFIG_ESP_TASK_WDT_EN=y
CONFIG_ESP_INT_WDT=y
CONFIG_ESP_TASK_WDT_TIMEOUT_S=60

CONFIG_ESPTOOLPY_FLASHFREQ_80M=y
CONFIG_SPIRAM=y
CONFIG_SPIRAM_SPEED_250M=y
CONFIG_SPIRAM_MALLOC_ALWAYSINTERNAL=128
```

## esp_codec_dev/test_apps/codec_dev_uac_test/sdkconfig.defaults
```kconfig
CONFIG_CODEC_UAC_SUPPORT=y
CONFIG_USB_HOST_CONTROL_TRANSFER_MAX_SIZE=2048

#
# ESP WDT CONFIG
#
CONFIG_ESP_TASK_WDT_EN=y
CONFIG_ESP_TASK_WDT_TIMEOUT_S=60
```

## esp_codec_dev/test_apps/codec_dev_uac_test/sdkconfig.defaults.esp32s3
```kconfig
CONFIG_CODEC_UAC_SUPPORT=y
CONFIG_USB_HOST_CONTROL_TRANSFER_MAX_SIZE=2048

CONFIG_ESP_MAIN_TASK_STACK_SIZE=10240
```
